## main/Kconfig.projbuild
```kconfig
menu "NFC Attendance System"

menu "Server Configuration"
config SERVER_URL
    string "Server URL"
    default "example.com"

choice TRANSFER_PROTOCOL
    prompt "Transfer Protocol"
    default TRANSFER_PROTOCOL_HTTPS

config TRANSFER_PROTOCOL_HTTP
    bool "http"
config TRANSFER_PROTOCOL_HTTPS
    bool "https"
endchoice

config VERIFY_SERVER_CERT
    bool "Verify Server SSL Certificate"
    default "y"
    depends on TRANSFER_PROTOCOL_HTTPS

config ENABLE_OTA
    bool "Enable OTA Update"
    default y
endmenu

menu "WiFi Configuration"
config WIFI_SSID
    string "WiFi SSID"
    default "myssid"

config WIFI_PASSWORD
    string "WiFi Password"
    default "mypassword"

config WIFI_HOSTNAME_PREFIX
    string "WiFi Hostname Prefix"
    default "NAS"

config ENABLE_SC_KEY
    bool "Enable SmartConfig Key"
    default y

config SC_KEY_HOLD_TIME
    int "SmartConfig Key Hold Time (ms)"
    default 500
    depends on ENABLE_SC_KEY

choice SC_KEY_ACTIVE_LEVEL
    prompt "SmartConfig Key Active Level"
    default SC_KEY_ACTIVE_LOW
    depends on ENABLE_SC_KEY

config SC_KEY_ACTIVE_HIGH
    bool "Active High"
config SC_KEY_ACTIVE_LOW
    bool "Active Low"
endchoice

config SC_KEY_PIN
    int "SmartConfig Key Pin"
    default 0
    depends on ENABLE_SC_KEY
endmenu

menu "NTP Configuration"
config NTP_SERVER_URL
    string "NTP Server URL"
    default "pool.ntp.org"

config NTP_TIMEZONE
    string "NTP Timezone"
    default "CST-8"
endmenu

menu "NFC Configuration"
config PN532_RST_PIN
    int "PN532 RST Pin"
    default 26

config PN532_TX_PIN
    int "PN532 TX Pin"
    default 17

config PN532_RX_PIN
    int "PN532 RX Pin"
    default 16
endmenu

menu "GUI Configuration"
config ENABLE_GUI
    bool "Enable GUI"
    default y

choice LCD_TYPE
    prompt "LCD Type"
    default LCD_TYPE_ST7789
    depends on ENABLE_GUI

config LCD_TYPE_ST7735
    bool "ST7735 80x160 LCD Panel"
config LCD_TYPE_ST7789
    bool "ST7789 135x240 LCD Panel"
endchoice

choice LCD_ORIENTATION
    prompt "LCD Orientation"
    default LCD_ORIENTATION_NORMAL
    depends on ENABLE_GUI

config LCD_ORIENTATION_NORMAL
    bool "Normal"
config LCD_ORIENTATION_UPSIDE_DOWN
    bool "Upside Down"
endchoice

config LCD_ROTATION_DEGREE
    int
    default  90 if LCD_ORIENTATION_NORMAL
    default 270 if LCD_ORIENTATION_UPSIDE_DOWN

config LCD_RST_PIN
    int "LCD RST Pin"
    default 14
    depends on ENABLE_GUI

config LCD_DC_PIN
    int "LCD DC Pin"
    default 23
    depends on ENABLE_GUI

config LCD_BL_PIN
    int "LCD BL Pin"
    default 4
    depends on ENABLE_GUI

config SPI_SCLK_PIN
    int "SPI SCLK Pin"
    default 5
    depends on ENABLE_GUI

config SPI_MOSI_PIN
    int "SPI MOSI Pin"
    default 18
    depends on ENABLE_GUI

config SPI_CS_PIN
    int "SPI CS Pin"
    default 27
    depends on ENABLE_GUI
endmenu

menu "LED Configuration"
config ENABLE_LED
    bool "Enable LED"
    default y

choice LED_ACTIVE_LEVEL
    prompt "LED Active Level"
    default LED_ACTIVE_HIGH
    depends on ENABLE_LED

config LED_ACTIVE_HIGH
    bool "Active High"
config LED_ACTIVE_LOW
    bool "Active Low"
endchoice

config LED_PIN
    int "LED Pin"
    default 25
    depends on ENABLE_LED
endmenu

menu "Audio Configuration"
config ENABLE_AUDIO_PROMPT
    bool "Enable Audio Prompt"
    default y

choice AUDIO_OUTPUT
    prompt "Audio Output"
    default AUDIO_OUTPUT_I2S1
    depends on ENABLE_AUDIO_PROMPT

    config AUDIO_OUTPUT_I2S0
        bool "I2S-0"
    config AUDIO_OUTPUT_I2S1
        bool "I2S-1"
endchoice

config AUDIO_OUTPUT_I2S_NUM
    int
    default 0 if AUDIO_OUTPUT_I2S0
    default 1 if AUDIO_OUTPUT_I2S1
    default 2 if !ENABLE_AUDIO_PROMPT

config I2S_BCLK_PIN
    int "I2S BCLK Pin"
    default 22
    depends on ENABLE_AUDIO_PROMPT

config I2S_LRCK_PIN
    int "I2S LRCK Pin"
    default 21
    depends on ENABLE_AUDIO_PROMPT

config I2S_DOUT_PIN
    int "I2S DOUT Pin"
    default 19
    depends on ENABLE_AUDIO_PROMPT
endmenu

endmenu
```

## sdkconfig.defaults
```kconfig
#
# Serial flasher config
#
CONFIG_ESPTOOLPY_FLASHMODE_QIO=y
CONFIG_ESPTOOLPY_FLASHFREQ_80M=y
CONFIG_ESPTOOLPY_FLASHSIZE_4MB=y

#
# Partition Table
#
CONFIG_PARTITION_TABLE_CUSTOM=y
CONFIG_PARTITION_TABLE_CUSTOM_FILENAME="partitions.csv"

#
# Compiler options
#
CONFIG_COMPILER_OPTIMIZATION_PERF=y

#
# ESP32-specific
#
CONFIG_ESP32_REV_MIN_1=y
CONFIG_ESP32_DEFAULT_CPU_FREQ_240=y

#
# Common ESP-related
#
CONFIG_ESP_TASK_WDT=n

#
# Newlib
#
CONFIG_NEWLIB_NANO_FORMAT=y

#
# FreeRTOS
#
CONFIG_FREERTOS_HZ=1000
```
